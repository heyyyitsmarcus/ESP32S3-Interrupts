## main/Kconfig.projbuild
```kconfig
menu "Sensor Node Configuration"

    choice FIRE_CHECKING
        prompt "Detection Mode"
        default CHECK_FOR_FIRE
        help
            Choose whether or not for the node to check its data for fires.
        config CHECK_FOR_FIRE
            bool "Enable Fire Checking"
        config NO_CHECKING
            bool "Disable Fire Checking"
        endchoice
    
    menu "Pin Definitions"

        menu "PMS5003"
            config PMS_RST_GPIO
            int "PMS_RST_GPIO"
            default 19

            config PMS_RXD_GPIO
            int "PMS_RXD_GPIO"
            default 20

            config PMS_TXD_GPIO
            int "PMS_TXD_GPIO"
            default 21

            config PMS_SET_GPIO
            int "PMS_SET_GPIO"
            default 47
        endmenu

        menu "BME280"
            config BME_SDA_GPIO
            int "BME_SDA_GPIO"
            default 41

            config BME_SCK_GPIO
            int "BME_SCK_GPIO"
            default 2
        endmenu

        menu "LORA"
            config LORA_RST_GPIO
            int "LORA_RST_GPIO"
            default 6

            config LORA_CS_GPIO
            int "LORA_CS_GPIO"
            default 7

            config LORA_MOSI_GPIO
            int "LORA_MOSI_GPIO"
            default 15

            config LORA_MISO_GPIO
            int "LORA_MISO_GPIO"
            default 16

            config LORA_SCK_GPIO
            int "LORA_SCK_GPIO"
            default 17
        endmenu

    endmenu

endmenu
```
